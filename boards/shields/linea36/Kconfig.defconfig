## boards/shields/linea36/Kconfig.defconfig
```kconfig
# Central Side Configuration
#
# The side on which the PS/2 mouse is connected MUST be the central side.
#
# By default zmk configures the LEFT side as the central side. But most people
# want to connect their pointing devices to the RIGHT side.
#
# So, you need to define that the central side is the one to which the
# pointing device is connected to.

if SHIELD_MY_BOARD
config SHIELD_LINEA36
    default "linea36"
endif
```

## boards/shields/linea36/Kconfig.shield
```kconfig
# Copyright (c) 2020 Pete Johanson
# SPDX-License-Identifier: MIT

config SHIELD_LINEA36
    def_bool $(shields_list_contains,linea36)

#config SHIELD_YK_DO52PRO_RIGHT
#    def_bool $(shields_list_contains,yk_do52pro_right)
```
